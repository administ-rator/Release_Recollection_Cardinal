## config/west.yml
```yaml
manifest:
  remotes:
    - name: zmkfirmware
      url-base: https://github.com/zmkfirmware
    - name: cardinal-sys
      url-base: https://github.com/cardinal-sys
    - name: ssbb
      url-base: https://github.com/ssbb
    - name: kot149
      url-base: https://github.com/kot149
    - name: caksoylar
      url-base: https://github.com/caksoylar
    - name: nuovotaka
      url-base: https://github.com/nuovotaka
    - name: badjeff
      url-base: https://github.com/badjeff
    - name: urob                              # ⑦⑧ zmk-helpers / zmk-tri-state
      url-base: https://github.com/urob

  projects:
    - name: zmk
      remote: zmkfirmware
      # 〈Known-Good Anchor〉— Build #227 (run 27451380456) が引いた上流に固定。
      # `main` のままだとビルドの度に上流が動き、同じコミットでも別物が焼き上がる。
      # 実機で無線動作を確認できている唯一の基準点なのでここへ錨を下ろす。
      revision: ff09f2d0c9f13a868c8f71d71d9348ade438e4b6
      path: zmk
      import: app/west.yml

    - name: zmk-pmw3610-driver
      remote: cardinal-sys
      revision: 35f2c40
      path: modules/zmk-pmw3610-driver

    - name: zmk-listeners
      remote: ssbb
      # `v1` はタグではなくブランチ。#227 時点の実コミットへ固定。
      revision: c240cea
      path: modules/zmk-listeners

    - name: zmk-mouse-gesture
      remote: cardinal-sys
      revision: efc89e1c3d758fd782c7bbea429161f0d1fddad3
      path: modules/zmk-mouse-gesture

    - name: zmk-scroll-snap
      remote: kot149
      # `v1` はブランチのため #227(1f8fc86) → #228(dd21a0f) で黙って動いていた。
      # 差分は docs のみだが再現性のため #227 時点へ固定。
      revision: 1f8fc86
      path: modules/zmk-scroll-snap

    - name: zmk-rgbled-widget
      remote: caksoylar
      revision: b0b8cc2
      path: modules/zmk-rgbled-widget
    - name: zmk-pointing-acceleration-alpha
      remote: nuovotaka
      revision: 780dfcd
      path: modules/zmk-pointing-acceleration-alpha
    - name: zmk-behavior-insomnia
      remote: badjeff
      revision: 0ce76ae
      path: modules/zmk-behavior-insomnia

    - name: zmk-helpers                       # ⑦ keymap 記述ヘルパーマクロ
      remote: urob
      revision: "7e0219e"
      path: modules/zmk-helpers

    - name: zmk-tri-state                     # ⑧ Swapper（スマート Cmd+Tab）
      remote: urob
      revision: "2007896"
      path: modules/zmk-tri-state

    - name: zmk-auto-layer                    # ⑨ Smart Num（数字入力で自動レイヤー）
      remote: urob
      revision: dfa7c69
      path: modules/zmk-auto-layer

  self:
    path: config
```
